/*************************************************************
                     时钟显示程序
程序编写：Fucp   2015-5-17
DIY套件  http://59tiaoba.taobao.com

单片机 IAP15W4K61S4  或者其他51	 晶振频率 18.432M  
文字字模软件用  PC2002	图片软件用 圆形图片取模软件 
逐列取模方式

电机旋转方向 顺时针 	 
/***********************************************************
说明：本程序支持配套遥控器调整时间
播放按键  切换调整 时、分、秒、月、日
加 按键：增加
减 按键：减少
menu按键： 时钟复位

遥控器按键1 ：平面显示文字+侧面显示时钟	 可调时
遥控器按键2 ：平面指针时钟+侧面显示文字
*************************************************************/
#include "NEW_8051.H"
#include "intrins.h"
#include "task.h"
#define FOSC 18432000L          //系统频率
#define BAUD 115200             //串口波特率
bit Scan_bit=0;	  
uint Offset=0;//文字偏移地址
uint OffsetAdder=0;//图片偏移地址
bit BIT_timeout=0;
uchar ucMode=2;	 //图片模式
bit Time0_flag=0;	//定时器T0中断标志位
uchar DISP_LINE=0;
uint Pt=50,S0,T,D;		//计数用的变量
uchar ucAdder=0;
/*********中断子程序**********/
void int0() interrupt 0	//使用外部中断0
{
	BIT_timeout=1; //起点标志位
	if(ucMode!=1)
	{	

		D+=(DISP_LINE-180)*2;   //修正值
	   	Pt=205+D; 
	    //得到定时器T0的初设值
		TH0=-Pt/256;
		TL0=-Pt%256;   //设置定时器T0的初设值
		DISP_LINE=0;   //计数器清零，将重新计数
		Offset++;
		 if(Offset>1408)//侧面有多少文字 这个值就对应改成  多少字*16 
			Offset=0;	
	
	}
}
/******************************************/
void Send_uart(unsigned char d)	  /*从串口发送数据*/
{
	  ES=0;
      SBUF=d;
	  while(TI==0);       //等待发送完毕
      TI=0;
	  ES=1;
}
/*************************************/
//图片切换以及模拟表盘显示函数
void display_pic()
{
	uchar date1,date2,date3,date4;
	if(DISP_LINE<180)
	{
		if(Time0_flag)
		{
		 	Time0_flag=0;
			Close();		
			date1=picture[DISP_LINE*4+0+OffsetAdder];
			date2=picture[DISP_LINE*4+1+OffsetAdder];
			date3=picture[DISP_LINE*4+2+OffsetAdder];
			date4=picture[DISP_LINE*4+3+OffsetAdder];
			Show_L(date1,date2,date3,date4);
		    Show_R(Lzimo[(DISP_LINE+Offset)*2],Lzimo[(DISP_LINE+Offset)*2+1]);//送16*16文字显示	
				
		}
      }
}
/*********************************************/
void Init(void)
{
   	P0M0=0X00;//初始化IO口 为准双向口
	P0M1=0X00;

	P1M0=0X00;
	P1M1=0X00;

	P2M0=0X00;
	P2M1=0X00;

	P3M0=0X00;
	P3M1=0X00;

	P4M0=0X00;
	P4M1=0X00;

	P5M0=0X00;
	P5M1=0X00;

	P6M0=0X00;
	P6M1=0X00;

	P7M0=0X00;
	P7M1=0X00;

	Show_R(0x55,0x55);//测试
	Show_L(0x55,0x55,0x55,0x55);//测试

AUXR &= 0x7F;		//定时器时钟12T模式
	TMOD &= 0xF0;		//设置定时器模式
	TMOD |= 0x01;		//设置定时器模式
	TL0 = 0xCD;		//设置定时初值
	TH0 = 0xFE;		//设置定时初值
	TF0 = 0;		//清除TF0标志
	TR0 = 1;		//定时器0开始计时
	ET0=1;

	AUXR &= 0xBF;		//定时器时钟12T模式
	TMOD &= 0x0F;		//设置定时器模式
	TMOD |= 0x20;		//设置定时器模式
	TL1 = 0x12;		//设置定时初值 155US
	TH1 = 0x12;		//设置定时重载值
	TF1 = 0;		//清除TF1标志
	ET1=1;
	TR1 = 0;		//定时器1开始计时

	SCON = 0x50; 
 	T2L = (65536 - (FOSC/4/BAUD));   //设置波特率重装值
    T2H = (65536 - (FOSC/4/BAUD))>>8;
    AUXR = 0x14;                //T2为1T模式, 并启动定时器2
    AUXR |= 0x01;               //选择定时器2为串口1的波特率发生器
   // ES = 1;                     //使能串口1中断

     IT0 = 1;    //外部中断为边沿触发
                   //设置INT0的中断类型 (1:仅下降沿 0:上升沿和下降沿)
     EX0 = 1;  //使能INT0中断

	 IT1=1;
	 EX1=1;//外部中断1 下降沿 中断
	 EA = 1;                 
}
/************************************/
void Timer0Interrupt(void) interrupt 1
{			 
    Time0_flag=1;	           //定时中断标志位置1;
	TH0=-Pt/256;TL0=-Pt%256;   //设置定时器T0的初设值
	DISP_LINE++;                    //计数
}
/*****主函数*****/
void main(void)
{
	Init();
	Send_uart(0x55);
	
    //主程序
   	while(1)
    {      	
    	
		if(ucMode==2)
		{
			display_pic();
		}
		 //BIT_timeout=1;
		if(BIT_timeout==1)	//起点判断
	 	{			
			BIT_timeout=0; //清零
			
			Scan_bit=1;// 起点检测到后 LED不再流水测试
			if( new_code ) //有红外按键
			{
				new_code=0;
				switch( key_code ) //根据不同的按键值执行不同的动作
				{	
				   case 0x0C:
					ucMode=0x02;//数字钟模式+侧面文字
				//	TR0 = 1;	
				break;

			
			
				
	
					default: break;
				}
				key_code=0;
			}
		
			
    
            
    		}   
    
		}
}
/*********************************************************************************/
/*************************************************************************************
************************************************************************************
***********************                                     ***************************
***********************    http://59tiaoba.taobao.com       ***************************
***********************                                     ***************************
************************************************************************************
**********************************************************************************/